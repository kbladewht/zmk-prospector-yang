## display-themes/Kconfig
```kconfig
config ZMK_PROSPECTOR_SCANNER_ORIGINAL
    bool "Prospector scanner themes on MS2 / MS18 / MS18T"
    depends on ZMK_DISPLAY && BT_OBSERVER && !ZMK_SPLIT && !ZMK_BLE
    help
      Restore the original scanner renderers on supported kblade shields using its existing
      local-state bridge. This does not turn the USB dongle into a BLE scanner.

config ZMK_PROSPECTOR_DYA_SETTINGS
    bool "DYA theme, palette and brightness settings"
    depends on ZMK_PROSPECTOR_SCANNER_ORIGINAL && ZMK_CUSTOM_SETTINGS && ZMK_STUDIO_RPC
    help
      Expose dongle_display_settings in DYA and apply changes from the LVGL
      thread. Requires the same main+dya core as the Prospector dongle project.

config ZMK_PROSPECTOR_BOOT_ANIMATION
    bool "One-shot CORNE scanner boot animation"
    depends on ZMK_PROSPECTOR_SCANNER_ORIGINAL && ZMK_PROSPECTOR_BROADCAST_SCANNER
    help
      Reveal CORNE with an amber scan beam, then fade into the saved theme.
      Uses LVGL timers without blocking USB, Studio RPC or BLE scanning.
```
